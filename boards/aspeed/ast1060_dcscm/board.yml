## boards/aspeed/ast1060_dcscm_amd/Kconfig.ast1060_dcscm_amd
```kconfig
# SPDX-License-Identifier: Apache-2.0
#
# Aspeed BIC AST1060 board configuration
#
# Copyright (c) 2021 ASPEED Technology Inc.

config BOARD_AST1060_DCSCM_AMD
	select SOC_AST1060
```

## boards/aspeed/ast1060_dual_flash_amd/board.yml
```yaml
board:
  name: ast1060_dual_flash_amd
  vendor: aspeed
  socs:
    - name: ast1060
```

## boards/aspeed/ast1060_dual_flash_dice/board.yml
```yaml
board:
  name: ast1060_dual_flash_dice
  vendor: aspeed
  socs:
    - name: ast1060
```

## boards/aspeed/ast10x0_mp/Kconfig.ast10x0_mp
```kconfig
# SPDX-License-Identifier: Apache-2.0
#
# Aspeed BIC AST1060 board configuration
#
# Copyright (c) 2021 ASPEED Technology Inc.

config BOARD_AST10X0_MP
	select SOC_AST1060
```

## boards/aspeed/ast2700_dcscm_amd/Kconfig.ast2700_dcscm_amd
```kconfig
# SPDX-License-Identifier: Apache-2.0
#
# Aspeed BIC AST1060 board configuration
#
# Copyright (c) 2021 ASPEED Technology Inc.

config BOARD_AST2700_DCSCM_AMD
	select SOC_AST1060
```

## boards/aspeed/ast2700a0_dcscm/Kconfig.ast2700a0_dcscm
```kconfig
# SPDX-License-Identifier: Apache-2.0
#
# Aspeed BIC AST1060 board configuration
#
# Copyright (c) 2021 ASPEED Technology Inc.

config BOARD_AST2700A0_DCSCM
	select SOC_AST1060
```

## west.yml
```yaml
# Copyright (c) 2022 ASPEED Technology Inc.
# SPDX-License-Identifier: MIT

manifest:
  self:
    path: aspeed-zephyr-project

  remotes:
    - name: github
      url-base: https://github.com/AspeedTech-BMC

  projects:
    - name: zephyr
      remote: github
      revision: 0132a9442cf34ace7022f67a63dcff170e703ae3
      import:
        name-whitelist:
          - mcumgr
          - cmsis
          - mcuboot
          - mbedtls
    - name: cerberus
      remote: github
      revision: c1d511b81e754999edd4e0f8f8a0c871fcad5473
      path: middlewares/cerberus
    - name: mcuboot
      remote: github
      revision: 6103efe89a65860a12fe7918028d469b82699270
      path: bootloader/mcuboot
```
